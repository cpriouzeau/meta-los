## conf/bblayers.conf.sample
```bitbake
# LAYER_CONF_VERSION is increased each time build/conf/bblayers.conf
# changes incompatibly
LCONF_VERSION = "6"

BBPATH = "${TOPDIR}"
BBFILES ?= ""
OEROOT := "${@os.path.abspath(os.path.dirname(d.getVar('FILE', True)) + '/../..')}"


BBLAYERS ?= " \
    ${OEROOT}/openembedded-core/meta \
    ${OEROOT}/meta-openembedded/meta-oe \
    ${OEROOT}/meta-openembedded/meta-systemd \
    ${OEROOT}/meta-openembedded/meta-webserver \
    ${OEROOT}/meta-openembedded/meta-multimedia \
    ${OEROOT}/meta-openembedded/meta-networking \
    ${OEROOT}/meta-openembedded/meta-python \
  "

BBLAYERS_NON_REMOVABLE ?= " \
  ${OEROOT}/openembedded-core/meta \
  "

# linaro
BBLAYERS += "${@'${OEROOT}/meta-linaro/meta-linaro' if os.path.isfile('${OEROOT}/meta-linaro/meta-linaro/conf/layer.conf') else ''}"
BBLAYERS += "${@'${OEROOT}/meta-linaro/meta-linaro-toolchain' if os.path.isfile('${OEROOT}/meta-linaro/meta-linaro-toolchain/conf/layer.conf') else ''}"
BBLAYERS += "${@'${OEROOT}/meta-linaro/meta-aarch64' if os.path.isfile('${OEROOT}/meta-linaro/meta-aarch64/conf/layer.conf') else ''}"
BBLAYERS += "${@'${OEROOT}/meta-openembedded/meta-networking' if os.path.isfile('${OEROOT}/meta-linaro/meta-linaro/conf/layer.conf') else ''}"


# specific to meta-browser
BBLAYERS += "${@'${OEROOT}/meta-browser' if os.path.isfile('${OEROOT}/meta-browser/conf/layer.conf') else ''}"
BBLAYERS += "${@'${OEROOT}/meta-openembedded/meta-gnome' if os.path.isfile('${OEROOT}/meta-browser/conf/layer.conf') else ''}"

# specific to los
BBLAYERS += "${@'${OEROOT}/meta-los' if os.path.isfile('${OEROOT}/meta-los/conf/layer.conf') else ''}"
```
